## boards/arm/eyelash_sofle/Kconfig.defconfig
```kconfig
if BOARD_EYELASH_SOFLE_LEFT || BOARD_EYELASH_SOFLE_RIGHT || BOARD_EYELASH_SOFLE_DONGLE

# Max 16 characters in keyboard name
config ZMK_KEYBOARD_NAME
    default "Eyelash Sofle"

config ZMK_SPLIT_ROLE_CENTRAL
    default y

config ZMK_SPLIT
    default y

# Set this to the number of peripherals your dongle will have.
# For a unibody, this would be 1. If you have left and right halves, set it to 2, etc.
config ZMK_SPLIT_BLE_CENTRAL_PERIPHERALS
    default 1

# Set this to ZMK_SPLIT_BLE_CENTRAL_PERIPHERALS + your desired number of BT profiles (default is 5)
config BT_MAX_CONN
    default 6

# Set this to the same number as BT_MAX_CONN
config BT_MAX_PAIRED
    default 6

endif






#
# Copyright (c) 2024 The ZMK Contributors
# SPDX-License-Identifier: MIT
#

#if BOARD_EYELASH_SOFLE_LEFT

#config ZMK_KEYBOARD_NAME
#    default "Eyelash Sofle"

#config ZMK_SPLIT_ROLE_CENTRAL
    default y

#endif # BOARD_EYELASH_SOFLE_LEFT


#if BOARD_EYELASH_SOFLE_LEFT || BOARD_EYELASH_SOFLE_RIGHT

#config BOARD
    default "eyelash_sofle"

#config BOARD_ENABLE_DCDC
#    bool "Enable DCDC mode"
#    select SOC_DCDC_NRF52X
#    default y
#    depends on (BOARD_EYELASH_SOFLE_LEFT || BOARD_EYELASH_SOFLE_RIGHT)

#config BOARD_ENABLE_DCDC_HV
#    bool "Enable High Voltage DCDC converter"
#    default y
#    select SOC_DCDC_NRF52X_HV
#    depends on (BOARD_EYELASH_SOFLE_LEFT || BOARD_EYELASH_SOFLE_RIGHT)

#config ZMK_SPLIT
#    default y

#config BT_CTLR
#    default BT

#if USB

#config USB_NRFX
    default y

#config USB_DEVICE_STACK
#    default y

#endif # USB

#if ZMK_DISPLAY

#config I2C
#    default y

#config SSD1306
#    default y

#choice ZMK_DISPLAY_WORK_QUEUE
#    default ZMK_DISPLAY_WORK_QUEUE_DEDICATED
#endchoice

#endif

#if SSD1306

#config LV_Z_VDB_SIZE
#    default 64

#config LV_DPI_DEF
#    default 148

#config LV_Z_BITS_PER_PIXEL
#    default 1

#choice LV_COLOR_DEPTH
#    default LV_COLOR_DEPTH_1
#endchoice

#endif

#if ZMK_BACKLIGHT

#config PWM
    default y

#config LED_PWM
    default y

#endif # ZMK_BACKLIGHT

#endif # BOARD_EYELASH_SOFLE_LEFT || BOARD_EYELASH_SOFLE_RIGHT
```

## boards/arm/eyelash_sofle/Kconfig.shield
```kconfig
# No whitespace after the comma or in the keyboard name!
config SHIELD_EYELASH_SOFLE_LEFT
    def_bool $(shields_list_contains,eyelash_sofle_left)

config SHIELD_EYELASH_SOFLE_RIGHT
    def_bool $(shields_list_contains,eyelash_sofle_right)
	
config SHIELD_EYELASH_SOFLE_DONGLE
    def_bool $(shields_list_contains,eyelash_sofle_dongle)
```

## config/west.yml
```yaml
manifest:
  remotes:
    - name: zmkfirmware
      url-base: https://github.com/zmkfirmware
      # Additional modules containing boards/shields/custom code can be listed here as well.
      # See:
      # - https://zmk.dev/docs/features/modules
      # - https://docs.zephyrproject.org/3.5.0/develop/west/manifest.html#projects
    - name: drMikeMiles                        #Gem
      url-base: https://github.com/drMikeMiles #Gem
#    - name: mctechnology17                        #LunaModify
#      url-base: https://github.com/mctechnology17 #LunaModify
##############################################################
  projects:
##############################################################
    - name: eyelash_sofle
      url: https://github.com/a741725193/zmk-sofle
      revision: refactor
##############################################################
    - name: Shield                         #Gem
      remote: drMikeMiles                  #Gem
      revision: main                       #Gem
##############################################################
 #   - name: zmk-nice-oled                  #LunaModify
 #     remote: mctechnology17               #LunaModify
 #     revision: main                       #LunaModify
##############################################################
    - name: zmk
      remote: zmkfirmware
      revision: main
      import: app/west.yml
##############################################################
  self:
    path: config
```
